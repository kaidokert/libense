SECTIONS
{
	.rcc 0x40023800 : {
		PROVIDE(.RCC_CR = . + 0x00);
		PROVIDE(.RCC_PLLCFGR = . + 0x04);
		PROVIDE(.RCC_CFGR = . + 0x08);
		PROVIDE(.RCC_CIR = . + 0x0C);
		PROVIDE(.RCC_AHB1RSTR = . + 0x10);
		PROVIDE(.RCC_AHB2RSTR = . + 0x14);
		PROVIDE(.RCC_AHB3RSTR = . + 0x18);
		PROVIDE(.RCC_AHB1ENR = . + 0x30);
		PROVIDE(.RCC_AHB2ENR = . + 0x34);
		PROVIDE(.RCC_AHB3ENR = . + 0x38);
		PROVIDE(.RCC_APB1ENR = . + 0x40);
		PROVIDE(.RCC_APB2ENR = . + 0x44);
		PROVIDE(.RCC_AHB1LPENR = . + 0x50);
		PROVIDE(.RCC_AHB2LPENR = . + 0x54);
		PROVIDE(.RCC_AHB3LPENR = . + 0x58);
		PROVIDE(.RCC_APB1LPENR = . + 0x60);
		PROVIDE(.RCC_APB2LPENR = . + 0x64);
		PROVIDE(.RCC_BDCR = . + 0x70);
		PROVIDE(.RCC_CSR = . + 0x74);
		PROVIDE(.RCC_SSCGR = . + 0x80);
		PROVIDE(.RCC_PLLI2SCFGR = . + 0x84);
		PROVIDE(.RCC_DCKCFGR = . + 0x8C);
	}
}
