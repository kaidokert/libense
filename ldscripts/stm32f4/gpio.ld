SECTIONS
{
	.gpio 0x40020000 : {
		PROVIDE(.GPIO_PORTA = . + 0x0000);
		PROVIDE(.GPIO_PORTB = . + 0x0400);
		PROVIDE(.GPIO_PORTC = . + 0x0800);
		PROVIDE(.GPIO_PORTD = . + 0x0C00);
		PROVIDE(.GPIO_PORTE = . + 0x1000);
		PROVIDE(.GPIO_PORTF = . + 0x1400);
		PROVIDE(.GPIO_PORTG = . + 0x1800);
		PROVIDE(.GPIO_PORTH = . + 0x1C00);
		PROVIDE(.GPIO_PORTI = . + 0x2000);
	}
}
